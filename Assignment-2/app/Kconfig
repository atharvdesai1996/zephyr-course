## Assignment-2/app/Kconfig
```kconfig
menuconfig LED_SUBSYSTEM
    bool "LED Subsystem"


    if LED_SUBSYSTEM

        choice
            prompt "LED blink sleep time"
            default BLINK_SLEEP_1000MS
            config BLINK_SLEEP_250MS
                bool "Fast (250ms)"
            config BLINK_SLEEP_1000MS
                bool "Medium (1s)"
            config BLINK_SLEEP_2000MS
                bool "Slow (2s)"
        endchoice

        config BLINK_SLEEP_TIME_MS  # use this in code
            int
            default 250  if BLINK_SLEEP_250MS
            default 1000 if BLINK_SLEEP_1000MS
            default 2000 if BLINK_SLEEP_2000MS
            default 0

        menuconfig LED_ADVANCED
            bool "Advanced LED settings"
            if LED_ADVANCED
                config LED_BRIGHTNESS
                    int "LED brightness (0-100)"
                    default 100
                    range 0 100
                config LED_FADE_DURATION_MS
                    int "Fade duration (ms)"
                    default 500
                    range 0 5000
            endif
        menu "Expert settings"
            visible if LED_ADVANCED
            config LED_DEBUG
                bool "Enable LED debugging"
            config CUSTOM_BLINK_PATTERN
                bool "Custom blink pattern"

endmenu

endif   # LED_SUBSYSTEM

source "Kconfig.zephyr"
```

## app/boards/my_board/board.yml
```yaml
board:
  name: my_board
  full_name: My Board from scratch
  vendor: iomico
  socs:
    - name: stm32u585xx
```

## app/boards/our_board/Kconfig.our_board
```kconfig
# Copyright (c) 2025 Arduino SA
# SPDX-License-Identifier: Apache-2.0

config BOARD_OUR_BOARD
	select SOC_STM32U585XX
```

## dts/bindings/our_driver.yaml
```yaml
description: Our Simple GPIO Driver
compatible: "our,driver"
include: base.yaml

properties:
  led-gpios:
    type: phandle-array
    required: true
    description: GPIO of the LED acting as our "sensor"
```
